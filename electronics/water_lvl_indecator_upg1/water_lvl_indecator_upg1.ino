#include <SPI.h>
#include <Wire.h>
#include <Adafruit_GFX.h>
#include <Adafruit_SSD1306.h>
#include <Keypad.h>


#define SCREEN_WIDTH 128 // OLED display width, in pixels
#define SCREEN_HEIGHT 64 // OLED display height, in pixels

// Declaration for an SSD1306 display connected to I2C (SDA, SCL pins)
#define OLED_RESET     -1 // Reset pin # (or -1 if sharing Arduino reset pin)
Adafruit_SSD1306 display(SCREEN_WIDTH, SCREEN_HEIGHT, &Wire, OLED_RESET);

#define NUMFLAKES     10 // Number of snowflakes in the animation example

#define LOGO_HEIGHT   16
#define LOGO_WIDTH    16
int trig = 2;
int echo = 3;

#include <stdint.h>


const byte ROWS = 4; //four rows
const byte COLS = 4; //three columns
char keys[ROWS][COLS] = {
  {'1', '4', '7', 'C'},
  {'2', '5', '8', '0'},
  {'3', '6', '9', '<'},
  {'E', '^', 'v', '>'}
};

byte rowPins[ROWS] = {4, 5, 6, 7}; //connect to the row pinouts of the keypad
byte colPins[COLS] = {8, 9, 10, 11}; //connect to the column pinouts of the keypad

Keypad keypad = Keypad( makeKeymap(keys), rowPins, colPins, ROWS, COLS );

static const unsigned char PROGMEM image_data_Untitled[] = {
  0xff, 0xff, 0xff, 0xff, 0xff, 0xff, 0xff, 0xff, 0xff, 0xff, 0xff, 0xff, 0xff, 0xff, 0xff, 0xff,
  0xc0, 0x84, 0x04, 0x07, 0x80, 0xc0, 0x00, 0x0f, 0xf0, 0x00, 0x3f, 0xc0, 0x0c, 0x00, 0x00, 0x07,
  0xc0, 0x84, 0x04, 0x07, 0x80, 0xc0, 0x00, 0x03, 0xf0, 0x00, 0x3f, 0xc0, 0x0c, 0x00, 0x00, 0x07,
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  0xff, 0xff, 0xff, 0xff, 0xff, 0xff, 0xff, 0xff, 0xff, 0xff, 0xff, 0xff, 0xff, 0xff, 0xff, 0xff
};


static const unsigned char PROGMEM image_data_Untitleood[] =  {
  0xff, 0xff, 0xff, 0xff, 0xff, 0xff, 0xff, 0xff, 0xff, 0xff, 0xff, 0xff, 0xff, 0xff, 0xff, 0xff,
  0xff, 0xff, 0xff, 0xff, 0xff, 0xff, 0xff, 0xff, 0xff, 0xff, 0xff, 0xff, 0xff, 0xff, 0xff, 0xff,
  0xff, 0xff, 0xff, 0xff, 0xff, 0xff, 0xff, 0xff, 0xff, 0xff, 0xff, 0xff, 0xff, 0xff, 0xff, 0xff,
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  0xff, 0xff, 0xff, 0xff, 0xff, 0xff, 0xff, 0xff, 0xff, 0xff, 0xff, 0xff, 0xff, 0xff, 0xff, 0xff
};

static const unsigned char PROGMEM image_data_Untitleod[]  = {
  0x00, 0x00, 0x00, 0x00, 0x00, 0x00, 0x00, 0x00, 0x00, 0x00, 0x00, 0x00, 0x00, 0x00, 0x00, 0x00,
  0x00, 0x00, 0x00, 0x00, 0x00, 0x00, 0x00, 0x00, 0x00, 0x00, 0x00, 0x00, 0x00, 0x00, 0x00, 0x00,
  0x00, 0x00, 0x00, 0x00, 0x00, 0x00, 0x00, 0x00, 0x00, 0x00, 0x00, 0x00, 0x00, 0x00, 0x00, 0x00,
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  0x00, 0x00, 0x00, 0x00, 0x00, 0x00, 0x00, 0x00, 0x00, 0x00, 0x00, 0x00, 0x00, 0x00, 0x00, 0x00
};

static const unsigned char PROGMEM image_data_Untitled11[] = {
  0xff, 0xff, 0xff, 0xff, 0xff, 0xff, 0xc0,
  0xff, 0xff, 0xff, 0xff, 0xff, 0xff, 0xc0,
  0xff, 0xff, 0xff, 0xff, 0xff, 0xff, 0xc0,
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  0xff, 0xff, 0xff, 0xff, 0xff, 0xff, 0xc0
};


static const unsigned char PROGMEM image_data_Untitled1[] = {
  0xbf, 0xff, 0xff, 0xff, 0xff, 0xff, 0x40,
  0xbf, 0xff, 0xff, 0xff, 0xff, 0xff, 0x40,
  0xbf, 0xff, 0xff, 0xff, 0xff, 0xff, 0x40,
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  0xff, 0xff, 0xff, 0xff, 0xff, 0xff, 0xc0
};

static const unsigned char PROGMEM image_data_Untitled2[] = {
  0x40, 0x00, 0x00, 0x00, 0x00, 0x00, 0x80,
  0x40, 0x00, 0x00, 0x00, 0x00, 0x00, 0x80,
  0x40, 0x00, 0x00, 0x00, 0x00, 0x00, 0x80,
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  0x00, 0x00, 0x00, 0x00, 0x00, 0x00, 0x00
};

static const unsigned char PROGMEM image_data_Untitled3[] = {
  0x40, 0x00, 0x00, 0x00, 0x00, 0x00, 0x80,
  0x40, 0x00, 0x00, 0x00, 0x00, 0x00, 0x80,
  0x40, 0x00, 0x00, 0x00, 0x00, 0x00, 0x80,
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  0x00, 0x00, 0x00, 0x00, 0x00, 0x00, 0x00
};
static const unsigned char PROGMEM image_data_Untitled4[] = {
  0x40, 0x00, 0x00, 0x00, 0x00, 0x00, 0x80,
  0x40, 0x00, 0x00, 0x00, 0x00, 0x00, 0x80,
  0x40, 0x00, 0x00, 0x00, 0x00, 0x00, 0x80,
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  0x00, 0x00, 0x00, 0x00, 0x00, 0x00, 0x00
};
static const unsigned char PROGMEM image_data_Untitled5[] = {
  0x40, 0x00, 0x00, 0x00, 0x00, 0x00, 0x80,
  0x40, 0x00, 0x00, 0x00, 0x00, 0x00, 0x80,
  0x40, 0x00, 0x00, 0x00, 0x00, 0x00, 0x80,
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  0x00, 0x00, 0x00, 0x00, 0x00, 0x00, 0x00
};

static const unsigned char PROGMEM image_data_Untitled6[] = {
  0x40, 0x00, 0x00, 0x00, 0x00, 0x00, 0x80,
  0x40, 0x00, 0x00, 0x00, 0x00, 0x00, 0x80,
  0x40, 0x03, 0x00, 0x00, 0x00, 0x00, 0x80,
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  0x00, 0x00, 0x00, 0x00, 0x00, 0x00, 0x00
};

void testdrawstyles(unsigned int a) {
  display.clearDisplay();
  display.setTextSize(2);             // Normal 1:1 pixel scale
  display.setTextColor(WHITE);        // Draw white text
  display.setCursor(0, 0);            // Start at top-left corner
  display.println(F("waterlevel"));
  display.setTextSize(2);             // Draw 2X-scale text
  display.setTextColor(WHITE);
  display.print("=");
  display.print(a);
  display.setTextSize(2);             // Draw 2X-scale text
  display.setTextColor(WHITE);
  display.print(F("%"));
  display.display();
  delay(1000);
}

void aninani(int a) {
  if (a >= 100)
  {
    digitalWrite(LED_BUILTIN, HIGH);   // turn the LED on (HIGH is the voltage level)
    display.drawBitmap(0, 35, image_data_Untitled11, 50, 30, 1);
    display.display();
    display.drawBitmap(65, 19, image_data_Untitled1, 50, 40, 1);
    display.display();
    delay(1000);
    digitalWrite(LED_BUILTIN, LOW);    // turn the LED off by making the voltage LOW
  }
  else if (a <= 5) {
    display.drawBitmap(65, 19, image_data_Untitled2, 50, 40, 1);
    display.display();
    delay(1000);
  }

  else if (a <= 25) {
    display.drawBitmap(65, 19, image_data_Untitled4, 50, 40, 1);
    display.display();
    delay(1000);


  }
  else if (a <= 50) {
    display.drawBitmap(65, 19, image_data_Untitled3, 50, 40, 1);
    display.display();
    delay(1000);

  }
  else if (a <= 75) {
    display.drawBitmap(65, 19, image_data_Untitled5, 50, 40, 1);
    display.display();
    delay(1000);

  }
  else if (a <= 99) {
    display.drawBitmap(65, 19, image_data_Untitled6, 50, 40, 1);
    display.display();
    delay(1000);

  }
}
  void keybards (char keys) {
    // put your main code here, to run repeatedly:
    char key = keypad.getKey();
    // just print the pressed key
    if (key) {
      digitalWrite(LED_BUILTIN, HIGH);   // turn the LED on (HIGH is the voltage level)
      display.clearDisplay();
      display.setTextSize(3);
      display.setTextColor(WHITE);
      display.setCursor(0, 0);
      display.println(key);
      display.display();

    }
    if (key == 'E') {
      display.println("ok :)");
      display.display();
      digitalWrite(LED_BUILTIN, LOW);    // turn the LED off by making the voltage LOW
    }



  }


void setup() {
  // initialize digital pin LED_BUILTIN as an output.
  pinMode(LED_BUILTIN, OUTPUT);
  Serial.begin(115200);
  pinMode(trig, OUTPUT);
  pinMode(echo, INPUT);

  // SSD1306_SWITCHCAPVCC = generate display voltage from 3.3V internally
  Serial.begin(115200);

  if (!display.begin(SSD1306_SWITCHCAPVCC, 0x3C)) {
    Serial.println(F("SSD1306 allocation failed"));
    for (;;);
  }
  delay(2000); // Pause for 2 seconds

  // Clear the buffer.
  display.clearDisplay();

  // Draw bitmap on the screen
  display.drawBitmap(0, 0, image_data_Untitled, 128, 64, 1);
  display.display();
  delay(5000);
  display.clearDisplay();
  display.drawBitmap(0, 0, image_data_Untitleood, 128, 64, 1);
  display.display();
  delay(5000);
  display.clearDisplay();
  display.drawBitmap(0, 0, image_data_Untitleod, 128, 64, 1);
  display.display();
  delay(5000);

  //testdrawstyles();    // Draw 'stylized' characters

}

void loop() {

  int t = 0, h = 0, hp = 0, n = 0;

  // Transmitting pulse
  digitalWrite(trig, LOW);
  delayMicroseconds(2);
  digitalWrite(trig, HIGH);
  delayMicroseconds(200);
  digitalWrite(trig, LOW);

  // Waiting for pulse
  t = pulseIn(echo, HIGH);


  // Calculating distance
  n = t / 58;

  n = n - 24;  // offset correction
  n = 17.50 - n;  // water height, 0 - 50 cm

  hp = 5.88 * n; // distance in %, 0-100 %

  // Sending to computer
  Serial.print(hp);
  Serial.print(t);
  // Serial.print(" cm\n");
  Serial.print("\n");

  delay(100);

  testdrawstyles(hp);
  aninani(hp);


}
